## firmware/main/Kconfig.projbuild
```kconfig
menu "Secure OTA"

    config SOTA_WIFI_SSID
        string "Wi-Fi SSID"
        default "changeme"

    config SOTA_WIFI_PASSWORD
        string "Wi-Fi password"
        default "changeme"

    config SOTA_WIFI_CONNECT_TIMEOUT_S
        int "Wi-Fi connection timeout (s)"
        default 20

    config SOTA_MANIFEST_URL
        string "Manifest URL"
        default "https://192.168.1.10:8443/manifest.json"

    config SOTA_ALLOW_HTTP
        bool "Allow plain HTTP for the firmware URL"
        default n

    config SOTA_CHECK_INTERVAL_S
        int "Update check interval (s)"
        default 60

    config SOTA_HTTP_TIMEOUT_MS
        int "HTTP timeout (ms)"
        default 10000

    config SOTA_SELF_TEST_MIN_FREE_HEAP
        int "Minimum free heap for the self-test (bytes)"
        default 40000

    config SOTA_DEMO_FORCE_SELF_TEST_FAILURE
        bool "Demo: force the self-test to fail"
        default n

    config SOTA_DEMO_CRASH_ON_BOOT
        bool "Demo: crash before the image is validated"
        default n

endmenu
```

## firmware/sdkconfig.defaults
```kconfig
CONFIG_IDF_TARGET="esp32"
CONFIG_ESPTOOLPY_FLASHSIZE_4MB=y
CONFIG_PARTITION_TABLE_CUSTOM=y
CONFIG_PARTITION_TABLE_CUSTOM_FILENAME="partitions.csv"
CONFIG_PARTITION_TABLE_FILENAME="partitions.csv"
CONFIG_PARTITION_TABLE_OFFSET=0x10000
CONFIG_BOOTLOADER_APP_ROLLBACK_ENABLE=y
CONFIG_BOOTLOADER_WDT_ENABLE=y
CONFIG_ESP_TASK_WDT_EN=y
CONFIG_ESP_SYSTEM_PANIC_PRINT_REBOOT=y
CONFIG_MBEDTLS_CERTIFICATE_BUNDLE=n
CONFIG_ESP_MAIN_TASK_STACK_SIZE=8192
```
